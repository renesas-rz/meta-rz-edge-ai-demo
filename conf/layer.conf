## conf/layer.conf
```bitbake
#We have a conf and classes directory, append to BBPATH
BBPATH .= ":${LAYERDIR}"

# We have a recipes directory, add to BBFILES
BBFILES += " \
        ${LAYERDIR}/recipes-*/*/*.bb \
        ${LAYERDIR}/recipes-*/*/*.bbappend \
"

BBFILE_COLLECTIONS += "meta-rz-edge-ai-demo-layer"
BBFILE_PATTERN_meta-rz-edge-ai-demo-layer := "^${LAYERDIR}/"
BBFILE_PRIORITY_meta-rz-edge-ai-demo-layer = "16"
LAYERSERIES_COMPAT_meta-rz-edge-ai-demo-layer = "dunfell"
PREFERRED_VERSION_opencv = "4.1.0-RZ"
PREFERRED_VERSION_ade = "0.1.1f-RZ"
PREFERRED_VERSION_armnn ?= "22.02%"
PREFERRED_VERSION_arm-compute-library ?= "22.02%"
PREFERRED_VERSION_tensorflow-lite = "2.5.3%"
```
